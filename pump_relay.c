/*
*******************************************************************************
** Name  : pump_relay.c
** Date  : 01.04.2023
** By    : I.Zaicev
** Notes :
*******************************************************************************
*/
#include "pump_relay.h"

/*
*******************************************************************************
**                        Variables
*******************************************************************************
*/

/*$PAGE$*/
/*
*******************************************************************************
** Description : Инициализация пина, для управлением реле насоса
** Parameter   : none
** Return      : none
** Notes       : PC0
*******************************************************************************
*/
void RelayPump_Init ( void )
{
    DDRC |= ( 1 << DDRC );
    PORTC &= ~( 1 << PORTC0 );
}
/*$PAGE$*/
/*
*******************************************************************************
** Description :
** Parameter   : none
** Return      : none
** Notes       :
*******************************************************************************
*/
void RelayPump_Function ( uint8_t f )
{
    if ( f == OFF ) {
        PORTC &= ~( 1 << PORTC0 );
    } else {
        PORTC |= ( 1 << PORTC0 );
    }
}
/*$PAGE$*/
/*
*******************************************************************************
** Description :
** Parameter   : none
** Return      : none
** Notes       : PF6 - L lewel, PF7 - H lewel
*******************************************************************************
*/
void PressureSensor_Init ( void )
{
    DDRF &= ~( ( 1 << PORTF6 ) | ( 1 << PORTF7 ) );
}
/*$PAGE$*/
/*
*******************************************************************************
** Description : Чтение датчиком мин и макс давления
** Parameter   : none
** Return      : 1 - сработал по минимуму
**               2 - сработал по максимуму
**               0 - норма
** Notes       : PF6 - L lewel, PF7 - H lewel
*******************************************************************************
*/
uint8_t PressureSensor_Read( void )
{
    uint8_t retVal = 0;
    if ( ( bit_is_clear ( PINF, PINF6 ) ) && ( bit_is_clear ( PINF, PINF7 ) ) ) {
        retVal = 0;
    } else if ( ( bit_is_set ( PINF, PINF6 ) ) && ( bit_is_clear ( PINF, PINF7 ) ) ) {
        retVal = 1;
    } else if ( ( bit_is_clear ( PINF, PINF6 ) ) && ( bit_is_set ( PINF, PINF7 ) ) ) {
        retVal = 2;
    } else {

    }

    return retVal;
}